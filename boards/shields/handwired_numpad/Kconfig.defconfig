## boards/shields/handwired_numpad/Kconfig.defconfig
```kconfig
if numpad_handwired

config ZMK_KEYBOARD_NAME
    default "Handwired Numpad"

endif
```

## boards/shields/handwired_numpad/Kconfig.shield
```kconfig
config SHIELD_HANDIWRED_NUMPAD
    def_bool $(shields_list_contains,handwired_numpad)
```
