/ {
    chosen { zmk,kscan = &kscan0; };
};

&kscan0 {
    compatible = "zmk,kscan-gpio";
    diode-direction = "col2row";              // oder "row2col" – passend zu deinen Dioden!
    // Reihen (R0..R3)
    row-gpios = <&gpio0 11 GPIO_ACTIVE_HIGH>, // P0.11
                <&gpio0 12 GPIO_ACTIVE_HIGH>, // P0.12
                <&gpio0 24 GPIO_ACTIVE_HIGH>, // P0.24
                <&gpio1 00 GPIO_ACTIVE_HIGH>; // P1.00
    // Spalten (C0..C4)
    col-gpios = <&gpio0 13 GPIO_ACTIVE_HIGH>, // P0.13
                <&gpio0 14 GPIO_ACTIVE_HIGH>, // P0.14
                <&gpio0 15 GPIO_ACTIVE_HIGH>, // P0.15
                <&gpio0 16 GPIO_ACTIVE_HIGH>, // P0.16
                <&gpio0 17 GPIO_ACTIVE_HIGH>; // P0.17

    debounce-press-delay-ms = <5>;
    debounce-release-delay-ms = <5>;
};
